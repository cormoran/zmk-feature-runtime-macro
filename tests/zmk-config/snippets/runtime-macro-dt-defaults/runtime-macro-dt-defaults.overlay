/*
 * A devicetree default macro node doesn't need to be bound to any keymap
 * position to be valid - it just needs to compile and install at boot, which
 * is all this build target verifies (see test.py). Real playback is covered
 * by the native_sim test suite (tests/dt-defaults).
 */
/ {
	runtime_macro_defaults {
		rmacro_default_0 {
			compatible = "cormoran,runtime-macro-default";
			macro-name = "Hi";
			text = "hi";
		};
	};
};
